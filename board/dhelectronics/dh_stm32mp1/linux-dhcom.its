## board/dhelectronics/dh_stm32mp1/linux-dhcom.its
```
/dts-v1/;

/ {
	description = "Linux and FDT for DHCOM STM32MP1";
	#address-cells = <1>;

	images {
		linux-1 {
			description = "Linux DHCOM STM32MP1";
			data = /incbin/("u-boot-nodtb.bin"); /* REPLACE ME with a real kernel image */
			type = "kernel";
			os = "linux";
			arch = "arm";
			compression = "none";
			load = <0xc4000000>;
			entry = <0xc4000000>;
			hash-1 {
				algo = "sha256";
			};
			signature-1 {
				algo = "sha256,KEY_ALGO";
				key-name-hint = "KEY_NAME_SSBL_IMG";
			};
		};

		fdt-1 {
			description = "FDT DHCOM STM32MP1";
			data = /incbin/("arch/arm/dts/stm32mp15xx-dhcom-pdk2.dtb"); /* REPLACE ME with a dtb from linux */
			type = "flat_dt";
			arch = "arm";
			compression = "none";
			hash-1 {
				algo = "sha256";
			};
			signature-1 {
				algo = "sha256,KEY_ALGO";
				key-name-hint = "KEY_NAME_SSBL_IMG";
			};
		};
	};

	configurations {
		default = "config-1";

		config-1 {
			description = "Linux and FDT for DHCOM STM32MP1";
			kernel = "linux-1";
			fdt = "fdt-1";
			signature-1 {
				algo = "sha256,KEY_ALGO";
				key-name-hint = "KEY_NAME_SSBL_CFG";
				sign-images = "kernel", "fdt";
			};

		};
	};
};
```

## board/dhelectronics/dh_stm32mp1/u-boot-dhcom.its
```
/dts-v1/;

/ {
	description = "U-Boot mainline";
	#address-cells = <1>;

	images {
		uboot {
			description = "U-Boot (32-bit)";
			data = /incbin/("u-boot-nodtb.bin");
			type = "standalone";
			os = "U-Boot";
			arch = "arm";
			compression = "none";
			load = <0xc0100000>;
			entry = <0xc0100000>;
			hash-1 {
				algo = "sha256";
			};
			signature {
				algo = "sha256,KEY_ALGO";
				key-name-hint = "KEY_NAME_FSBL_IMG";
			};
		};

		fdt-1 {
			description = ".dtb";
			data = /incbin/("arch/arm/dts/stm32mp15xx-dhcom-pdk2.dtb");
			type = "flat_dt";
			arch = "arm";
			compression = "none";
			hash-1 {
				algo = "sha256";
			};
			signature {
				algo = "sha256,KEY_ALGO";
				key-name-hint = "KEY_NAME_FSBL_IMG";
			};
		};

		fdt-2 {
			description = ".dtb";
			data = /incbin/("arch/arm/dts/stm32mp15xx-dhcom-drc02.dtb");
			type = "flat_dt";
			arch = "arm";
			compression = "none";
			hash-1 {
				algo = "sha256";
			};
			signature {
				algo = "sha256,KEY_ALGO";
				key-name-hint = "KEY_NAME_FSBL_IMG";
			};
		};

		fdt-3 {
			description = ".dtb";
			data = /incbin/("arch/arm/dts/stm32mp15xx-dhcom-picoitx.dtb");
			type = "flat_dt";
			arch = "arm";
			compression = "none";
			hash-1 {
				algo = "sha256";
			};
			signature {
				algo = "sha256,KEY_ALGO";
				key-name-hint = "KEY_NAME_FSBL_IMG";
			};
		};
	};

	configurations {
		default = "config-1";

		config-1 {
			/* DT+SoM+board model */
			description = "dh,stm32mp15xx-dhcom-pdk2_somrev0_boardrev0";
			firmware = "uboot";
			fdt = "fdt-1";
			signature {
				algo = "sha256,KEY_ALGO";
				key-name-hint = "KEY_NAME_FSBL_CFG";
				sign-images = "firmware", "fdt";
			};
		};

		config-2 {
			/* DT+SoM+board model */
			description = "dh,stm32mp15xx-dhcom-pdk2_somrev1_boardrev0";
			firmware = "uboot";
			fdt = "fdt-1";
			signature {
				algo = "sha256,KEY_ALGO";
				key-name-hint = "KEY_NAME_FSBL_CFG";
				sign-images = "firmware", "fdt";
			};
		};

		config-3 {
			/* DT+SoM+board model */
			description = "dh,stm32mp15xx-dhcom-drc02_somrev0_boardrev0";
			firmware = "uboot";
			fdt = "fdt-2";
			signature {
				algo = "sha256,KEY_ALGO";
				key-name-hint = "KEY_NAME_FSBL_CFG";
				sign-images = "firmware", "fdt";
			};
		};

		config-4 {
			/* DT+SoM+board model */
			description = "dh,stm32mp15xx-dhcom-drc02_somrev1_boardrev0";
			firmware = "uboot";
			fdt = "fdt-2";
			signature {
				algo = "sha256,KEY_ALGO";
				key-name-hint = "KEY_NAME_FSBL_CFG";
				sign-images = "firmware", "fdt";
			};
		};

		config-5 {
			/* DT+SoM+board model */
			description = "dh,stm32mp15xx-dhcom-picoitx_somrev0_boardrev0";
			firmware = "uboot";
			fdt = "fdt-3";
			signature {
				algo = "sha256,KEY_ALGO";
				key-name-hint = "KEY_NAME_FSBL_CFG";
				sign-images = "firmware", "fdt";
			};
		};

		config-6 {
			/* DT+SoM+board model */
			description = "dh,stm32mp15xx-dhcom-picoitx_somrev1_boardrev0";
			firmware = "uboot";
			fdt = "fdt-3";
			signature {
				algo = "sha256,KEY_ALGO";
				key-name-hint = "KEY_NAME_FSBL_CFG";
				sign-images = "firmware", "fdt";
			};
		};

		/* Add 587-100..587-400 with fdt-2..fdt-4 here */
	};
};
```
